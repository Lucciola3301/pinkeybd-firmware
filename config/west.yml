## config/west.yml
```yaml
manifest:
  remotes:
    - name: zmkfirmware
      url-base: https://github.com/zmkfirmware
    - name: pinkeybd-firmware
      url-base: https://github.com/ktkhshi/pinkeybd-firmware
    - name: zephyrproject-rtos
      url-base: https://github.com/zephyrproject-rtos
    - name: ktkhshi
      url-base: https://github.com/ktkhshi
    - name: ryo-aoki-pc
      url-base: https://github.com/ryo-aoki-pc
  projects:
    - name: zmk
      remote: zmkfirmware
      revision: v0.3.0
      import: app/west.yml
    - name: zephyr
      remote: zmkfirmware
      revision: v3.5.0+zmk-fixes
      clone-depth: 1
      import:
        name-blocklist:
          - ci-tools
          - hal_altera
          - hal_cypress
          - hal_infineon
          - hal_microchip
          - hal_nxp
          - hal_openisa
          - hal_silabs
          - hal_xtensa
          - hal_st
          - hal_ti
          - loramac-node
          - mcuboot
          - mcumgr
          - net-tools
          - openthread
          - edtt
          - trusted-firmware-m
    - name: nanopb
      revision: zmk
      path: modules/lib/nanopb
      remote: zmkfirmware
    - name: zmk-studio-messages
      revision: 6cb4c283e76209d59c45fbcb218800cd19e9339d
      path: modules/msgs/zmk-studio-messages
      remote: zmkfirmware
    - name: zmk-pmw3610-driver
      remote: ktkhshi
      revision: main
    - name: zmk-input-processor-aml-threshold
      remote: ryo-aoki-pc
      revision: 98f317118e81c6fe9df5e88fc5acc554ecbc9af1
  self:
    west-commands: scripts/west-commands.yml
```
